## conf/distro/mysecuredistro.conf
```bitbake
# Configuration of "mysecuredistro"
DISTRO_NAME = "My Secure Distro (based on OpenEmbedded)"
DISTRO_VERSION = "1.0.0"
DISTRO_FEATURES += " systemd security seccomp"
DISTRO_FEATURES:remove =  "alsa bluetooth nfs 3g nfc x11"
DISTRO_EXTRA_RDEPENDS = ""
DISTRO_EXTRA_RRECOMMENDS = ""
TCLIBC = "glibc"

PACKAGE_CLASSES += "package_ipk"
INHERIT += "${PACKAGE_CLASSES} devshell sstate license remove-libtool create-spdx"
INHERIT += "create-spdx"

INIT_MANAGER = "systemd"

require conf/distro/include/security_flags.inc
```

## conf/layer.conf
```bitbake
# We have a conf and classes directory, add to BBPATH
BBPATH .= ":${LAYERDIR}"

# We have recipes-* directories, add to BBFILES
BBFILES += "${LAYERDIR}/recipes-*/*/*.bb \
            ${LAYERDIR}/recipes-*/*/*.bbappend"

BBFILE_COLLECTIONS += "meta-mysecuredistro"
BBFILE_PATTERN_meta-mysecuredistro = "^${LAYERDIR}/"
BBFILE_PRIORITY_meta-mysecuredistro = "6"

LAYERDEPENDS_meta-mysecuredistro = "core security"
LAYERSERIES_COMPAT_meta-mysecuredistro = "scarthgap"
```
